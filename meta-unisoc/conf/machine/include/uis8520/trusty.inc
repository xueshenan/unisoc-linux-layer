## meta-unisoc/conf/machine/ums9620-1h10.conf
```bitbake
#@TYPE: Machine
#@NAME: ums9620-1h10 machine
#@DESCRIPTION: UNISOC ums9620-1h10 machine

require conf/machine/include/ums9620/ums9620.inc
require conf/machine/include/ums9620/trusty.inc
require conf/machine/include/ums9620/video.inc
require conf/machine/include/ums9620/camera.inc
#require conf/machine/include/ums9620/gpu.inc

# wayland shoud be in distro featue???

# unisoc common configuration
require conf/machine/include/common/unisoc-common.inc

# support dual-sim
require conf/machine/include/common/dual-sim.inc

# rootfs use ext4 or ubifs ? use ext4
require conf/machine/include/common/ext4-def.inc

# FEATURE frist close
# MACHINE_FEATURES = "rsyslogsetup modem radio production usbcontrol perflink"
# MACHINE_FEATURES += "android-tools-adbd"
# MACHINE_FEATURES += "engpc terminal unirlog"
# MACHINE_FEATURES += "gnss-adapter"
# MACHINE_FEATURES += "npi-support"
# MACHINE_FEATURES += "libteec teerpc sprdstorage tsupplicant"
# MACHINE_FEATURES += "engmodeapp"
# MACHINE_FEATURES += "sleepwakeup"
MACHINE_FEATURES += "fsckmsdos"

SUPPORT_SSHD = "${@bb.utils.contains('USERDEBUG','userdebug','ssh-server-openssh','',d)}"
# For board plugins support
#BOARD_PLUGINS_SUPPORT = "test common wcn-recovery"
DAEMON_INITTAB = "k1:5:respawn:/usr/sbin/ofonod -nd -p uncdev,unisoc,unisocmodem,bluez5,hfp_ag_bluez5,hfp_bluez5,hfpmodem+"
#MACHINE_ADD_DISTRO_FEATURES = "pulseaudio"

KERNEL_BOARD = "ums9620-1h10"
KERNEL_DT_SUBDIR = "${@bb.utils.contains('DEFAULTTUNE','aarch64','sprd/','',d)}"

# bsp use same ums9620-2h10
# uboot now use ums9620_2h10
UBOOT_BOARD = "ums9620_1h10"
UBOOT_BOARD_pn-u-boot15 = "ums9620_2h10"


# MACHINE_FEATURES += "upower suspendblocker "
# current need define KERNEL_DEFCONFIG and DTB
KERNEL_DEFCONFIG = "sprd_ums9620_defconfig"
KERNEL_MACHINE_PATCH = "file://ums9620-1h10.cfg \
	               "

# for recovery kernel image
KERNEL_RECOVERY_DEFCONFIG = "recovery_ums9620_defconfig"
KERNEL_PATCH_FOR_RECOVERY = "file://recovery-ums9620-1h10.cfg \
                        "

CHIPRAM_MACHINE_PATCH = ""

U_BOOT_MACHINE_PATCH = ""


CHIPRAM_SUPPORT_BOTH_EMMC_UFS = "no"

EXTRA_IMAGEDEPENDS += "u-boot15"
EXTRA_IMAGEDEPENDS += "chipram"

SUPPORT_VOICECALL = "true"

# KERNEL_MODULE_AUTOLOAD += "cpufreq_userspace"
# KERNEL_MODULE_AUTOLOAD += "sprd_ddr_dvfs"
# KERNEL_MODULE_AUTOLOAD += "sprd_soc_thm sprd_cpu_cooling sprd_gpu_cooling"
# KERNEL_MODULE_AUTOLOAD += "sprd-cpufreq-v2 sprd-cpufreq-public"

# todo : could add to conf/machine/include/common/ext4-def.inc
# note : prodnv userdata and swupdate not
EXTRA_IMAGECMD_ext4_pn-unisoc-wayland-image = "-i 4096 -b 4096"
```

## meta-unisoc/conf/machine/ums9620-2h10-k515.conf
```bitbake
#@TYPE: Machine
#@NAME: ums9620-2h10-k515-k515 machine
#@DESCRIPTION: UNISOC ums9620-2h10-k515-k515 machine

require conf/machine/include/ums9620/ums9620.inc
require conf/machine/include/ums9620/trusty.inc
require conf/machine/include/ums9620/video.inc
require conf/machine/include/ums9620/camera.inc
#require conf/machine/include/ums9620/gpu.inc

# unisoc common configuration
require conf/machine/include/common/unisoc-common.inc

# support dual-sim
require conf/machine/include/common/dual-sim.inc

# rootfs use ext4 or ubifs ? use ext4
require conf/machine/include/common/ext4-def.inc


MACHINE_FEATURES = "rsyslogsetup modem"


### console configuration
# console config need same as kernel cmdline
CONSOLE_LINUX = "ttyS1"
CONSOLE = "${CONSOLE_LINUX}"
SERIAL_CONSOLES = "115200;ttyS1"


KERNEL_BOARD_BASE = "ums9620-base"
KERNEL_BOARD = "ums9620-2h10"
UNISOC_KERNEL_VERSION = "linux-unisoc-5.15"
KERNEL_DT_SUBDIR = "${@bb.utils.contains('DEFAULTTUNE','aarch64','sprd/','',d)}"


UBOOT_BOARD = "ums9620_2h10"

# current need define KERNEL_DEFCONFIG and DTB
KERNEL_DEFCONFIG = "ums9620_k515_defconfig"
KERNEL_MACHINE_PATCH = "file://kernel-config/ums9620-2h10.cfg \
             file://kernel-config/kernel-module-sysdump.cfg \
             file://kernel-config/kernel-module-modem.cfg \
             file://close-SND-SOC.cfg \
            "


# for recovery kernel image
KERNEL_RECOVERY_DEFCONFIG = "recovery_ums9620_k515_defconfig"
KERNEL_PATCH_FOR_RECOVERY = "file://kernel-config/recovery-ums9620-2h10.cfg \
            "



CHIPRAM_MACHINE_PATCH = ""

U_BOOT_MACHINE_PATCH = ""

# for dtbo make
BSP_BUILD_DT_OVERLAY = "y"
export BSP_BUILD_DT_OVERLAY

BSP_BUILD_ANDROID_OS = "y"
export BSP_BUILD_ANDROID_OS

BSP_BUILD_FAMILY = "qogirn6pro"
export BSP_BUILD_FAMILY
# end for dtbo make

CHIPRAM_SUPPORT_BOTH_EMMC_UFS = "yes"

EXTRA_IMAGEDEPENDS += "u-boot15"
EXTRA_IMAGEDEPENDS += "chipram"

SUPPORT_VOICECALL = "true"

IMAGE_INSTALL_append += " libgcc-dev "
```

## meta-unisoc/conf/machine/ums9620-2h10.conf
```bitbake
#@TYPE: Machine
#@NAME: ums9620-2h10 machine
#@DESCRIPTION: UNISOC ums9620-2h10 machine

require conf/machine/include/ums9620/ums9620.inc
require conf/machine/include/ums9620/trusty.inc
require conf/machine/include/ums9620/video.inc
require conf/machine/include/ums9620/camera.inc
require conf/machine/include/ums9620/gpu.inc

# support wayland feature
require conf/machine/include/wayland.inc

# unisoc common configuration
require conf/machine/include/common/unisoc-common.inc

# support dual-sim
require conf/machine/include/common/dual-sim.inc

# rootfs use ext4 or ubifs ? use ext4
require conf/machine/include/common/ext4-def.inc

MACHINE_FEATURES = "rsyslogsetup modem radio production usbcontrol perflink strongswan thermald pppd"
MACHINE_FEATURES += "libcamera"
MACHINE_FEATURES += "focaltech-ft8756-spi"
MACHINE_FEATURES += "yt6801"
MACHINE_FEATURES += "aw9523b"
MACHINE_FEATURES += "gt1x"
MACHINE_FEATURES += "android-tools-adbd"
MACHINE_FEATURES += "userdata-resize2fs fs_tools"
MACHINE_FEATURES += "engpc terminal unirlog"
MACHINE_FEATURES += "nativemmi"
MACHINE_FEATURES += "bt-tool"
MACHINE_FEATURES += "gnss-adapter"
MACHINE_FEATURES += "${@bb.utils.contains('USERDEBUG','userdebug','networkutils','',d)}"
MACHINE_FEATURES += "npi-support"
MACHINE_FEATURES += "libteec teerpc sprdstorage tsupplicant"
MACHINE_FEATURES += "engmodeapp"
MACHINE_FEATURES += "sleepwakeup"
MACHINE_FEATURES += "autoreboot"
MACHINE_FEATURES += "sysdump"
MACHINE_FEATURES += "wpa-supplicant"
MACHINE_FEATURES += "libbt hciattach bluetooth"
MACHINE_FEATURES += "bt-tool"
MACHINE_FEATURES += "fsckmsdos"
MACHINE_FEATURES += "imgtec"
MACHINE_FEATURES += "ntpdaemon"
MACHINE_FEATURES += "localtime"
MACHINE_FEATURES += "lmbench"
MACHINE_FEATURES_append = " ltp"
MACHINE_FEATURES += "aiactiver"
MACHINE_FEATURES += "vdsp"
MACHINE_FEATURES += "qtdemo"
MACHINE_FEATURES += "video memion"
MACHINE_FEATURES += "jpeg"
MACHINE_FEATURES += "${@bb.utils.contains('USERDEBUG','userdebug','tracetool','',d)}"
MACHINE_FEATURES += "st-module"
MACHINE_FEATURES += "qfactorytest"
MACHINE_FEATURES += "qlauncher"
MACHINE_FEATURES += "middlewaresvc"

#Audio
MACHINE_FEATURES += "alsa audiohal-phoenix pulseaudio voicecall gstreamer audio-phoenix"
MACHINE_FEATURES += "gnss"
# use whale hal in audio
USE_AUDIO_WHALE_HAL = "true"

MACHINE_FEATURES += "charge"
MACHINE_FEATURES += "batterymanager"
MACHINE_FEATURES += "rebootinfo"
SUPPORT_SSHD = "ssh-server-openssh"
# For board plugins support
#BOARD_PLUGINS_SUPPORT = "test common wcn-recovery"
DAEMON_INITTAB = "k1:5:respawn:/usr/sbin/ofonod -nd -p uncdev,unisoc,unisocmodem,bluez5,hfp_ag_bluez5,hfp_bluez5,hfpmodem+"
MACHINE_ADD_DISTRO_FEATURES = "pulseaudio bluetooth"

# localtime
IMAGE_FEATURES_append_pn-unisoc-wayland-image = "prc-localtime"

# if system have symbolic link localtime, enable tele sync time with nitz
TELE_CFLAGS += "${@bb.utils.contains('IMAGE_FEATURES','prc-localtime','-DNITZ_SYNC_TINE_SUPPORT','',d)}"


# gpu
export GPU_BOARD = "ums9620-2h10"
MACHINE_FEATURES += "mali-natt glmark2"

KERNEL_BOARD = "ums9620-2h10"
KERNEL_DT_SUBDIR = "${@bb.utils.contains('DEFAULTTUNE','aarch64','sprd/','',d)}"
UBOOT_BOARD = "ums9620_2h10"
SENSOR_BOARD="ums9620_2h10"
MACHINE_FEATURES += "sensorhub-cm4"

### open ch support for modem_ctrl
MODEM_CTRL_SUPPORT_CH = "-DCONFIG_CH_SUPPORT"
MODEM_CTRL_NR_MODEM = "-DCONFIG_NR_MODEM"

### open agdsp support for slogmodem
SUPPORT_AGDSP = "-DCONFIG_AGDSP_SUPPORT"

MACHINE_FEATURES += "upower suspendblocker "
MACHINE_FEATURES += "wcnini-marlin3lite wifitest-sc2355 wlan-combo"
# current need define KERNEL_DEFCONFIG and DTB
KERNEL_DEFCONFIG = "sprd_ums9620_defconfig"
KERNEL_MACHINE_PATCH = "file://ums9620-2h10.cfg \
			file://ums9620-2h10-audio.cfg \
			file://0001-Bug-1982891-change-androidboot-to-sprdboot-in-n6pro.patch \
			file://0002-fix-user-compile-error.patch \
			file://0003-enable-trusty-vendor-hook.patch \
	               "

# for recovery kernel image
KERNEL_RECOVERY_DEFCONFIG = "recovery_ums9620_defconfig"
KERNEL_PATCH_FOR_RECOVERY = "file://recovery-ums9620-2h10.cfg \
                         file://0001-Bug-1982891-change-androidboot-to-sprdboot-in-n6pro.patch \
                         file://0002-fix-user-compile-error.patch \
                        "

CHIPRAM_MACHINE_PATCH = ""

U_BOOT_MACHINE_PATCH = ""


CHIPRAM_SUPPORT_BOTH_EMMC_UFS = "yes"

EXTRA_IMAGEDEPENDS += "u-boot15"
EXTRA_IMAGEDEPENDS += "chipram"

SUPPORT_VOICECALL = "true"

# video omx avc
ADD_OMX_AVC_DEC_HW = "libomxavcdechwsprd"
ADD_OMX_AVC_DEC_SW = "libomxavcdecswsprd"
ADD_OMX_AVC_ENC_HW = "libomxavcenchwsprd"
ADD_UTEST_AVC_DEC = ""
ADD_UTEST_AVC_ENC = ""
ADD_STGFRT_AVC_DEC = "libstagefrightsprdh264dec"
ADD_STGFRT_AVC_ENC = "libstagefrightsprdh264enc"
# video omx m4v h263
ADD_OMX_M4V_H263_DEC_HW = ""
ADD_OMX_M4V_H263_DEC_SW = "libomxm4vh263decswsprd"
ADD_OMX_M4V_H263_ENC_SW = "libomxm4vh263encswsprd"
ADD_UTEST_M4V_H263_DEC = ""
ADD_UTEST_M4V_H263_ENC = ""
ADD_STGFRT_M4V_H263_DEC = "libstagefrightsprdmpeg4dec"
ADD_STGFRT_M4V_H263_ENC = "libstagefrightsprdmpeg4enc"
# video omx hevc
ADD_OMX_HEVC_DEC_HW = "libomxhevcdechwsprd"
ADD_OMX_HEVC_ENC_HW = "libomxhevcenchwsprd"
ADD_UTEST_HEVC_DEC = ""
ADD_UTEST_HEVC_ENC = ""
ADD_STGFRT_HEVC_DEC = "libstagefrightsprdh265dec"
ADD_STGFRT_HEVC_ENC = "libstagefrightsprdh265enc"
# video omx vpx
ADD_OMX_VP8_DEC_HW = "libomxvpxdechwsprd"
ADD_UTEST_VP8_DEC = ""
ADD_STGFRT_VP8_DEC = "libstagefrightsprdvpxdec"
# video omx vp9
ADD_OMX_VP9_DEC_HW = "libomxvp9dechwsprd"
ADD_UTEST_VP9_DEC = ""
ADD_STGFRT_VP9_DEC = "libstagefrightsprdvp9dec"
###end video###

# kernel modules autoload
# wcn_bsp driver
KERNEL_MODULE_AUTOLOAD +="wcn_bsp"

#gnss driver
KERNEL_MODULE_AUTOLOAD +="gnss_common_ctl_all gnss_pnnotify_ctl gnss_dbg"

#for iperf
IPERF_VERSION = "iperf2"

# trusty driver
KERNEL_MODULE_AUTOLOAD +="trusty-log"

# bt driver
KERNEL_MODULE_AUTOLOAD +="sprdbt_tty"

KERNEL_MODULE_AUTOLOAD += "cpufreq_userspace"
KERNEL_MODULE_AUTOLOAD += "sprd_ddr_dvfs"
KERNEL_MODULE_AUTOLOAD += "sprd_soc_thm sprd_cpu_cooling sprd_gpu_cooling sprd_npu_cooling"
KERNEL_MODULE_AUTOLOAD += "sprd-cpufreq-v2 sprd-cpufreq-public"

# time sync
KERNEL_MODULE_AUTOLOAD += "sprd_systimer sprd_time_sync sprd_time_sync_cp"

# video codec driver
KERNEL_MODULE_AUTOLOAD += "vpu sprd_vpu_pw_domain jpg"

# support nativemmi
NTVM_CFG = "ums9620-2h10"

# support selinux
DISTRO_FEATURES_append = "selinux xattr"
DEFAULT_ENFORCING = "enforcing"
```

## meta-unisoc/conf/machine/unisoc-qemuarm64.conf
```bitbake
# qemu

require conf/machine/qemuarm64.conf
require conf/machine/include/unisoc-extern.inc

# kernel bin use OE layer
PEFERRED_PROVIDER_virtual/kernel ?= "linux-yocto"
PREFERRED_VERSION_linux-yocto ?= "5.4%"
KERNEL_MACHINE_PATCH = ""
KMACHINE_pn-linux-yocto = "qemuarm64"

# not compile uboot and chipram
EXTRA_IMAGEDEPENDS_remove = "chipram"
EXTRA_IMAGEDEPENDS_remove = "u-boot15"
U_BOOT_MACHINE_PATCH = ""


MACHINEOVERRIDES =. "qemuarm64;"


# remove unuse package
CORE_IMAGE_EXTRA_INSTALL_remove += " signature-key swupdate u-boot-fw-utils swupdate-service "


MACHINE_FEATURES += " modem "
```
