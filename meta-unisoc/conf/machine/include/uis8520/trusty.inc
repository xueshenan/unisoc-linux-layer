## meta-unisoc/conf/machine/include/uis8520/trusty.inc
```bitbake
BOARD_SECBOOT_CONFIG = "${@bb.utils.contains('SECBOOT_ENABLE','sec','true','false',d)}"
UNISOC_SIGN_ENABLE = "yes"
UNISOC_SIGN_PSS = "pss"
PROJECT_FLAG = "OTHER"
BSP_SPRD_SECUREBOOT_ALGORITHM = "rsa4096"
SECURE_WCN_GNSS_ENABLE = "${@bb.utils.contains('SECBOOT_ENABLE','sec','true','false',d)}"

### SECBOOT_ENABLE configuration which influence compile
### START secboot and vbootv2 configs for uboot
UBOOT_SECSET = "${@bb.utils.contains('SECBOOT_ENABLE','sec','-DCONFIG_SECBOOT -DCONFIG_SPRD_SECBOOT -DPKCS1_PSS_FLAG','',d)}"
UBOOT_SECSET += "${@bb.utils.contains('SECURE_WCN_GNSS_ENABLE','true','-DVERIFY_WCN_GNSS','',d)}"
### END secboot and vbootv2 configs for uboot

### START secboot and vbootv2 configs for chipram
CHIPRAM_SECSET = "${@bb.utils.contains('SECBOOT_ENABLE','sec','-DCONFIG_SECBOOT -DCONFIG_SPRD_SECBOOT -DPKCS1_PSS_FLAG','',d)}"
### END secboot and vbootv2 configs for chipram

### START secboot and vbootv2 configs for modem_ctrl
MODEM_SECSET = "${@bb.utils.contains('SECBOOT_ENABLE','sec','-DCONFIG_SECBOOT -DCONFIG_SPRD_SECBOOT','',d)}"
MODEM_LDKERNELBOOTCP = "${@bb.utils.contains('SECBOOT_ENABLE','sec','-lkernelbootcp','',d)}"
### END secboot and vbootv2 configs for modem_ctrl
### END BOARD_SECBOOT_CONFIG

### START SML/TEECFG/TOS configs ###
SML_VERSION = "1.4"
SML_CONFIG = "qogirn6pro@qogirn6pro"
TEE_CONFIG = "trusty"
SML_MEM_ADDR ?= "0xbd000000"
SML_MEM_SIZE ?= "0x00040000"

TEECFG_CUSTOM = "true"
TEECFG_MEM_ADDR ?= "0xbd040000"
TEECFG_MEM_SIZE ?= "0x20000"

TEE_64BIT = "true"
TRUSTY_DEFAULT_PROJECT = "sl9620"
TOS_MEM_ADDR ?= "0xbd060000"
TOS_MEM_SIZE ?= "0x01fa0000"


EXTRA_IMAGEDEPENDS += "sml"
EXTRA_IMAGEDEPENDS += "teecfg"
EXTRA_IMAGEDEPENDS += "trusty"
### END SML and TOS configs ###
```

## meta-unisoc/conf/machine/include/uis8520/uis8520.inc
```bitbake
require conf/machine/include/arm/arch-arm64.inc

UNISOC_SOC = "uis8520"
KERNEL_BOARD_BASE = "uis8520"

UNISOC_KERNEL_VERSION = "linux-unisoc-5.4"
PREFERRED_PROVIDER_virtual/kernel = "${UNISOC_KERNEL_VERSION}"

KERNEL_IMAGETYPE = "Image"
UNISOC_BOOTIMG_PAGE_SIZE = "2048"
UNISOC_BOOTIMG_KERNEL_BASE = "0x00000000"
BOARD_MKBOOTIMG_ARGS = "--kernel_offset 0x00008000 --ramdisk_offset 0x012e9800"

SENSOR_PROJECT="QogirN6Pro_CH"
EXTRA_IMAGEDEPENDS += "u-boot15"
EXTRA_IMAGEDEPENDS += "chipram"
```

## meta-unisoc/conf/machine/include/ums9620/ums9620.inc
```bitbake
require conf/machine/include/arm/arch-arm64.inc

UNISOC_SOC = "ums9620"
KERNEL_BOARD_BASE = "ums9620"

UNISOC_KERNEL_VERSION = "linux-unisoc-5.4"
PREFERRED_PROVIDER_virtual/kernel = "${UNISOC_KERNEL_VERSION}"

KERNEL_IMAGETYPE = "Image"
UNISOC_BOOTIMG_PAGE_SIZE = "2048"
UNISOC_BOOTIMG_KERNEL_BASE = "0x00000000"
BOARD_MKBOOTIMG_ARGS = "--kernel_offset 0x00008000 --ramdisk_offset 0x012e9800"

SENSOR_PROJECT="QogirN6Pro_CH"
EXTRA_IMAGEDEPENDS += "u-boot15"
EXTRA_IMAGEDEPENDS += "chipram"

N6P_5G_SET = "-DN6P_5G_SUPPORT"
```

## meta-unisoc/conf/machine/include/ums9620/video.inc
```bitbake
###for video###
JPG_PLATFORM := "r8p0"
VSP_PLATFORM = "vpu"
VPP_PLATFORM = "sharkl3"
BOARD_PLATFORM = "sp9863a"
BIA_SUPPORT = "true"
AFBC = "false"
RGB_ENC_SUPPORT = "true"

# video omx avc
ADD_OMX_AVC_DEC_HW = "libomxavcdechwsprd"
ADD_OMX_AVC_DEC_SW = "libomxavcdecswsprd"
ADD_OMX_AVC_ENC_HW = "libomxavcenchwsprd"
ADD_UTEST_AVC_DEC = "utestvspavch264dec"
ADD_UTEST_AVC_ENC = "utestvspavch264enc"
ADD_STGFRT_AVC_DEC = "libstagefrightsprdh264dec"
ADD_STGFRT_AVC_ENC = "libstagefrightsprdh264enc"
# video omx m4v h263
ADD_OMX_M4V_H263_DEC_HW = "libomxm4vh263dechwsprd"
ADD_OMX_M4V_H263_DEC_SW = "libomxm4vh263decswsprd"
ADD_OMX_M4V_H263_ENC_SW = "libomxm4vh263encswsprd"
ADD_UTEST_M4V_H263_DEC = "utestvspm4vh263dec"
ADD_UTEST_M4V_H263_ENC = "utestvspm4vh263enc"
ADD_STGFRT_M4V_H263_DEC = "libstagefrightsprdmpeg4dec"
ADD_STGFRT_M4V_H263_ENC = "libstagefrightsprdmpeg4enc"
# video omx hevc
ADD_OMX_HEVC_DEC_HW = "libomxhevcdechwsprd"
ADD_OMX_HEVC_ENC_HW = "libomxhevcenchwsprd"
ADD_UTEST_HEVC_DEC = "utestvsphevch265dec"
ADD_UTEST_HEVC_ENC = "utestvsphevch265enc"
ADD_STGFRT_HEVC_DEC = "libstagefrightsprdh265dec"
ADD_STGFRT_HEVC_ENC = "libstagefrightsprdh265enc"
# video omx vpx
ADD_OMX_VP8_DEC_HW = "libomxvpxdechwsprd"
ADD_UTEST_VP8_DEC = "utestvspvpxdec"
ADD_STGFRT_VP8_DEC = "libstagefrightsprdvpxdec"
# video omx vp9
ADD_OMX_VP9_DEC_HW = "libomxvp9dechwsprd"
ADD_UTEST_VP9_DEC = "utestvspvp9dec"
ADD_STGFRT_VP9_DEC = "libstagefrightsprdvp9dec"
###end video###
```
