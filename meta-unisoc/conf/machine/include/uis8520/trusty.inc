## meta-unisoc/conf/machine/include/wayland.inc
```bitbake
#@TYPE: product
#@NAME: graphic product
#@DESCRIPTION: UNISOC GRAPHIC product
MACHINE_FEATURES_append = " graphic qtconfig lvgl lvdrv lvgldemo lvinit lvglota source-hansans-cn-medium-otf "
```

## meta-unisoc/conf/machine/recovery.conf
```bitbake
# Config for recovery os(swupdate)
LAYERDEPENDS_unisoc = "swupdate"

#BBFILES += "${@' '.join('${LAYERDIR}/%s/recipes*/*/*.%s' % (layer, ext) \
#               for layer in '${BBFILE_COLLECTIONS}'.split() for ext in ['bb', 'bbappend'])}"

PREFERRED_PROVIDER_u-boot-fw-utils = "libubootenv"
CORE_IMAGE_EXTRA_INSTALL_append = " signature-key swupdate u-boot-fw-utils swupdate-service "

PREFERRED_PROVIDER_virtual/recovery-kernel := "${UNISOC_KERNEL_VERSION}-recovery"
```

## meta-unisoc/conf/machine/s9863a-1h10-otadev.conf
```bitbake
#@TYPE: Machine
#@NAME: s9863a-1h10-otadev machine
#@DESCRIPTION: UNISOC s9863a-1h10-otadev machine

require conf/machine/include/s9863a/s9863a.inc
require conf/machine/include/s9863a/trusty.inc
require conf/machine/include/s9863a/video.inc
require conf/machine/include/s9863a/camera.inc
require conf/machine/include/s9863a/gpu.inc

# unisoc common configuration
require conf/machine/include/common/unisoc-common.inc

# use rogue-um or mesa? use rogue-um instead of mesa for EGL & GLES libraries
require conf/machine/include/common/graphic-rogue-um.inc

# support dual-sim
require conf/machine/include/common/dual-sim.inc

# rootfs use ext4 or ubifs ? use ext4
require conf/machine/include/common/ext4-def.inc

AB_PARTITIONS = "true"
#MACHINE_FEATURES = " modem radio engpc usbcontrol powertop rsyslogsetup perflink terminal"

#MACHINE_FEATURES = "charge modem radio engpc usbcontrol powertop rsyslogsetup perflink terminal memion userdata-resize2fs fs_tools android-tools-adbd autoreboot pppd"
MACHINE_FEATURES = "usbcontrol powertop rsyslogsetup perflink terminal memion userdata-resize2fs fs_tools android-tools-adbd autoreboot"

MACHINE_FEATURES += "ota"

SUPPORT_SSHD = "${@bb.utils.contains('USERDEBUG','userdebug','ssh-server-openssh','',d)}"

# For board plugins support
#BOARD_PLUGINS_SUPPORT = "test common wcn-recovery"
DAEMON_INITTAB = "k1:5:respawn:/usr/sbin/ofonod -nd -p uncdev,unisoc,unisocmodem,bluez5,hfp_ag_bluez5,hfp_bluez5,hfpmodem+"
#MACHINE_ADD_DISTRO_FEATURES = "pulseaudio bluetooth"

# MACHINE kernel/bsp/chipram source code configuration file
KERNEL_BOARD = "sp9863a-1h10-otadev"
KERNEL_DT_SUBDIR = "${@bb.utils.contains('DEFAULTTUNE','aarch64','sprd/','',d)}"
UBOOT_BOARD = "sl8581e_1h10_otadev"
SENSOR_BOARD="s9863a1h10"
MACHINE_FEATURES += "sensorhub-cm4"

#KERNEL_DEVICETREE_OVERLAY ?= "sp9863a-1h10-overlay.dtbo"


# current! need define KERNEL_DEFCONFIG
KERNEL_DEFCONFIG = "sprd_s9863a_defconfig"
KERNEL_MACHINE_PATCH = "file://s9863a-1h10-otadev.cfg \
                        ${@bb.utils.contains('PN', 'linux-unisoc-5.4', 'file://0002-s9863a-1h10-otadev-dtbo-in-makefile.patch', '', d)} \
			"

# for recovery kernel image
KERNEL_RECOVERY_DEFCONFIG = "recovery_s9863a_defconfig"
KERNEL_PATCH_FOR_RECOVERY = "file://recovery-s9863a-1h10-otadev.cfg \
                        "

KERNEL_PATCH_FOR_RECOVERY = ""

CHIPRAM_MACHINE_PATCH = ""

U_BOOT_MACHINE_PATCH = ""

SUPPORT_VOICECALL = "true"

# for ofono teleservices dualsim
MULTI_SIM_SET = "-DMULTI_SIM_SUPPORT"

IMAGE_FEATURES_append_pn-unisoc-wayland-image = " prc-localtime"

# if system have symbolic link localtime, enable tele sync time with nitz
TELE_CFLAGS += "${@bb.utils.contains('IMAGE_FEATURES','prc-localtime','-DNITZ_SYNC_TINE_SUPPORT','',d)}"

# Engpc chnl config
#ENGPC_CHNL = "wifionly"
```

## meta-unisoc/conf/machine/s9863a-1h10.conf
```bitbake
#@TYPE: Machine
#@NAME: s9863a-1h10 machine
#@DESCRIPTION: UNISOC s9863a-1h10 machine

require conf/machine/include/s9863a/s9863a.inc
require conf/machine/include/s9863a/trusty.inc
require conf/machine/include/s9863a/video.inc
require conf/machine/include/s9863a/camera.inc
require conf/machine/include/s9863a/gpu.inc

# support wayland feature
require conf/machine/include/wayland.inc

# unisoc common configuration
require conf/machine/include/common/unisoc-common.inc

# use rogue-um or mesa? use rogue-um instead of mesa for EGL & GLES libraries
require conf/machine/include/common/graphic-rogue-um.inc

# support dual-sim
require conf/machine/include/common/dual-sim.inc

# rootfs use ext4 or ubifs ? use ext4
require conf/machine/include/common/ext4-def.inc

MACHINE_FEATURES = "charge modem radio engpc usbcontrol powertop rsyslogsetup perflink terminal thermald memion userdata-resize2fs fs_tools android-tools-adbd autoreboot pppd strongswan ntpdaemon localtime"
MACHINE_FEATURES += "ltp libcamera sysdump trusty production bt-tool wpa-supplicant stress-cicd"
MACHINE_FEATURES += "focaltech-ats"
MACHINE_FEATURES += "npi-support"
MACHINE_FEATURES += "unirlog"
MACHINE_FEATURES += "libteec teerpc sprdstorage tsupplicant"
MACHINE_FEATURES += "engmodeapp"
MACHINE_FEATURES += "wcnini-marlin2 wifitest-sc2332 wlan-combo libbt hciattach bluetooth"
MACHINE_FEATURES += "nativemmi"
MACHINE_FEATURES += "gnss-adapter"
MACHINE_FEATURES += "${@bb.utils.contains('USERDEBUG','userdebug','networkutils','',d)}"
MACHINE_FEATURES += "qtdemo lmbench"
MACHINE_FEATURES += "sleepwakeup"
MACHINE_FEATURES += "bt-tool"
MACHINE_FEATURES += "fsckmsdos"

MACHINE_FEATURES += "batterymanager"
MACHINE_FEATURES += "video"
MACHINE_FEATURES += "jpeg"
MACHINE_FEATURES += "ota"
MACHINE_FEATURES += "linuxptp"
MACHINE_FEATURES += "st-module"

# audio
MACHINE_FEATURES += "alsa audiohal-phoenix pulseaudio voicecall gstreamer audio-phoenix"
MACHINE_FEATURES += "gnss"
MACHINE_FEATURES += "upower suspendblocker "

MACHINE_FEATURES += "${@bb.utils.contains('USERDEBUG','userdebug','tracetool','',d)}"
MACHINE_FEATURES += "rebootinfo"
SUPPORT_SSHD = "ssh-server-openssh"
# For board plugins support
#BOARD_PLUGINS_SUPPORT = "test common wcn-recovery"
DAEMON_INITTAB = "k1:5:respawn:/usr/sbin/ofonod -nd -p uncdev,unisoc,unisocmodem,bluez5,hfp_ag_bluez5,hfp_bluez5,hfpmodem+"
MACHINE_ADD_DISTRO_FEATURES = "pulseaudio bluetooth"

# MACHINE kernel/bsp/chipram source code configuration file
KERNEL_BOARD = "sp9863a-1h10"
KERNEL_DT_SUBDIR = "${@bb.utils.contains('DEFAULTTUNE','aarch64','sprd/','',d)}"
UBOOT_BOARD = "sl8581e_1h10"
SENSOR_BOARD="s9863a1h10"
MACHINE_FEATURES += "sensorhub-cm4"

# current! need define KERNEL_DEFCONFIG
KERNEL_DEFCONFIG = "sprd_s9863a_defconfig"
KERNEL_MACHINE_PATCH = "file://s9863a-1h10.cfg \
                        file://kernel_pppsupport.cfg \
			file://0001-Bug-1982891-change-L3-patch-androidboot-to-sprdboot.patch \
			"
# for recovery kernel image
KERNEL_RECOVERY_DEFCONFIG = "recovery_s9863a_defconfig"
KERNEL_PATCH_FOR_RECOVERY = "file://recovery-s9863a-1h10.cfg \
                        "


CHIPRAM_MACHINE_PATCH = ""

U_BOOT_MACHINE_PATCH = ""

CHIPRAM_SUPPORT_BOTH_EMMC_UFS = "no"

SUPPORT_VOICECALL = "true"

###for video###
JPG_PLATFORM := "r8p0"
VSP_PLATFORM = "iwhale2"
VPP_PLATFORM = "sharkl3"
BOARD_PLATFORM = "sp9863a"
BIA_SUPPORT = "true"
AFBC = "false"
RGB_ENC_SUPPORT = "true"

#for iperf
IPERF_VERSION = "iperf2"

# video omx avc
ADD_OMX_AVC_DEC_HW = "libomxavcdechwsprd"
ADD_OMX_AVC_DEC_SW = "libomxavcdecswsprd"
ADD_OMX_AVC_ENC_HW = "libomxavcenchwsprd"
ADD_UTEST_AVC_DEC = ""
ADD_UTEST_AVC_ENC = ""
ADD_STGFRT_AVC_DEC = "libstagefrightsprdh264dec"
ADD_STGFRT_AVC_ENC = "libstagefrightsprdh264enc"
# video omx m4v h263
ADD_OMX_M4V_H263_DEC_HW = "libomxm4vh263dechwsprd"
ADD_OMX_M4V_H263_DEC_SW = "libomxm4vh263decswsprd"
ADD_OMX_M4V_H263_ENC_SW = "libomxm4vh263encswsprd"
ADD_UTEST_M4V_H263_DEC = ""
ADD_UTEST_M4V_H263_ENC = ""
ADD_STGFRT_M4V_H263_DEC = "libstagefrightsprdmpeg4dec"
ADD_STGFRT_M4V_H263_ENC = "libstagefrightsprdmpeg4enc"
# video omx hevc
ADD_OMX_HEVC_DEC_HW = "libomxhevcdechwsprd"
ADD_OMX_HEVC_ENC_HW = "libomxhevcenchwsprd"
ADD_UTEST_HEVC_DEC = ""
ADD_UTEST_HEVC_ENC = ""
ADD_STGFRT_HEVC_DEC = "libstagefrightsprdh265dec"
ADD_STGFRT_HEVC_ENC = "libstagefrightsprdh265enc"
# video omx vpx
ADD_OMX_VP8_DEC_HW = "libomxvpxdechwsprd"
ADD_UTEST_VP8_DEC = ""
ADD_STGFRT_VP8_DEC = "libstagefrightsprdvpxdec"
# video omx vp9
ADD_OMX_VP9_DEC_HW = "libomxvp9dechwsprd"
ADD_UTEST_VP9_DEC = ""
ADD_STGFRT_VP9_DEC = "libstagefrightsprdvp9dec"
###end video###

IMAGE_FEATURES_append_pn-unisoc-wayland-image = "prc-localtime"

# if system have symbolic link localtime, enable tele sync time with nitz
TELE_CFLAGS += "${@bb.utils.contains('IMAGE_FEATURES','prc-localtime','-DNITZ_SYNC_TINE_SUPPORT','',d)}"

# Engpc chnl config
#ENGPC_CHNL = "wifionly"

# kernel modules autoload
# wcn_bsp driver
KERNEL_MODULE_AUTOLOAD +="wcn_bsp"

# gnss driver
KERNEL_MODULE_AUTOLOAD +="gnss_common_ctl_all gnss_pmnotify_ctl gnss_dbg"

# trusty driver
KERNEL_MODULE_AUTOLOAD +="trusty-log"

# bt driver
KERNEL_MODULE_AUTOLOAD +="sprdbt_tty"

# ddr_dfs driver
KERNEL_MODULE_AUTOLOAD += "sprd_ddr_dvfs"

# cpu_dvfs driver
KERNEL_MODULE_AUTOLOAD += "sprd-cpufreq-v2 sprd-cpufreq-public"

# ap&cp timer sync
KERNEL_MODULE_AUTOLOAD += "sprd_time_sync_cp"

# video codec driver
KERNEL_MODULE_AUTOLOAD += "vsp sprd_vsp_pw_domain jpg"

# disp pm domain sharkl3
KERNEL_MODULE_AUTOLOAD += "sprd_disp_pm_domain_sharkl3"

# support selinux
DISTRO_FEATURES_append = "selinux xattr"
DEFAULT_ENFORCING = "enforcing"

BIND_PROCESS_TO_PDP = "-DBIND_PROCESS_TO_PDP_SUPPOURT"
```

## meta-unisoc/conf/machine/uis8520-haps-spi-nand.conf
```bitbake
#@TYPE: Machine
#@NAME: uis8520-haps-spi-nand-k515 machine
#@DESCRIPTION: UNISOC uis8520-haps-spi-nand-k515 machine

require conf/machine/include/uis8520/uis8520.inc
require conf/machine/include/uis8520/trusty.inc
require conf/machine/include/uis8520/video.inc
require conf/machine/include/uis8520/camera.inc
#require conf/machine/include/uis8520/gpu.inc

# unisoc common configuration
require conf/machine/include/common/unisoc-common.inc

# support dual-sim
require conf/machine/include/common/dual-sim.inc

# rootfs use ext4 or ubifs ? use ext4
require conf/machine/include/common/ubifs-def.inc


MACHINE_FEATURES = "rsyslogsetup modem"


### console configuration
# console config need same as kernel cmdline
CONSOLE_LINUX = "ttyS1"
CONSOLE = "${CONSOLE_LINUX}"
SERIAL_CONSOLES = "115200;ttyS1"


KERNEL_BOARD_BASE = "uis8520-haps-spi-nand"
KERNEL_BOARD = "uis8520-haps-spi-nand"
UNISOC_KERNEL_VERSION = "linux-unisoc-5.15"
KERNEL_DT_SUBDIR = "${@bb.utils.contains('DEFAULTTUNE','aarch64','sprd/','',d)}"


UBOOT_BOARD = "uis8520_haps_spi_nand"

# current need define KERNEL_DEFCONFIG and DTB
KERNEL_DEFCONFIG = "uis8520_haps_spi_nand_defconfig"
KERNEL_MACHINE_PATCH = "file://kernel-config/uis8520-haps-spi-nand.cfg \
             file://kernel-config/kernel-module-sysdump.cfg \
             file://kernel-config/kernel-module-modem.cfg \
			 file://close-SND-SOC.cfg \
             file://add-dtbo-haps-and-zebu.patch \
            "


# for recovery kernel image
KERNEL_RECOVERY_DEFCONFIG = "recovery_uis8520_haps_spi_nand_defconfig"
KERNEL_PATCH_FOR_RECOVERY = "file://kernel-config/recovery-uis8520-haps-spi-nand.cfg \
            "



CHIPRAM_MACHINE_PATCH = ""

U_BOOT_MACHINE_PATCH = ""

# for dtbo make
BSP_BUILD_DT_OVERLAY = "y"
export BSP_BUILD_DT_OVERLAY

BSP_BUILD_ANDROID_OS = "y"
export BSP_BUILD_ANDROID_OS

BSP_BUILD_FAMILY = "uis8520-haps-spi-nand"
export BSP_BUILD_FAMILY
# end for dtbo make

CHIPRAM_SUPPORT_BOTH_EMMC_UFS = "yes"

EXTRA_IMAGEDEPENDS += "u-boot15"
EXTRA_IMAGEDEPENDS += "chipram"

IMAGE_INSTALL_append += " libgcc-dev "
```

## meta-unisoc/conf/machine/uis8520-k515-haps.conf
```bitbake
#@TYPE: Machine
#@NAME: uis8520-k515-haps-k515 machine
#@DESCRIPTION: UNISOC uis8520-k515-haps-k515 machine

require conf/machine/include/uis8520/uis8520.inc
require conf/machine/include/uis8520/trusty.inc
require conf/machine/include/uis8520/video.inc
require conf/machine/include/uis8520/camera.inc
#require conf/machine/include/uis8520/gpu.inc

# unisoc common configuration
require conf/machine/include/common/unisoc-common.inc

# support dual-sim
require conf/machine/include/common/dual-sim.inc

# rootfs use ext4 or ubifs ? use ext4
require conf/machine/include/common/ext4-def.inc


MACHINE_FEATURES = "rsyslogsetup modem"


### console configuration
# console config need same as kernel cmdline
CONSOLE_LINUX = "ttyS1"
CONSOLE = "${CONSOLE_LINUX}"
SERIAL_CONSOLES = "115200;ttyS1"


KERNEL_BOARD_BASE = "uis8520-k515-haps"
KERNEL_BOARD = "uis8520-k515-haps"
UNISOC_KERNEL_VERSION = "linux-unisoc-5.15"
KERNEL_DT_SUBDIR = "${@bb.utils.contains('DEFAULTTUNE','aarch64','sprd/','',d)}"


UBOOT_BOARD = "uis8520_k515_haps"

# current need define KERNEL_DEFCONFIG and DTB
KERNEL_DEFCONFIG = "uis8520_k515_haps_defconfig"
KERNEL_MACHINE_PATCH = "file://kernel-config/uis8520-k515-haps.cfg \
             file://kernel-config/kernel-module-sysdump.cfg \
             file://kernel-config/kernel-module-modem.cfg \
			 file://close-SND-SOC.cfg \
             file://add-dtbo-haps-and-zebu.patch \
            "


# for recovery kernel image
KERNEL_RECOVERY_DEFCONFIG = "recovery_uis8520_k515_haps_defconfig"
KERNEL_PATCH_FOR_RECOVERY = "file://kernel-config/recovery-uis8520-k515-haps.cfg \
            "



CHIPRAM_MACHINE_PATCH = ""

U_BOOT_MACHINE_PATCH = ""

# for dtbo make
BSP_BUILD_DT_OVERLAY = "y"
export BSP_BUILD_DT_OVERLAY

BSP_BUILD_ANDROID_OS = "y"
export BSP_BUILD_ANDROID_OS

BSP_BUILD_FAMILY = "uis8520haps"
export BSP_BUILD_FAMILY
# end for dtbo make

CHIPRAM_SUPPORT_BOTH_EMMC_UFS = "yes"

EXTRA_IMAGEDEPENDS += "u-boot15"
EXTRA_IMAGEDEPENDS += "chipram"

IMAGE_INSTALL_append += " libgcc-dev "
```
