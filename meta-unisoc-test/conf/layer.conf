## meta-unisoc-test/conf/layer.conf
```bitbake
# We might have a conf and classes directory, append to BBPATH
BBPATH .= ":${LAYERDIR}"

# We have a recipes directory, add to BBFILES
BBFILES += "${LAYERDIR}/recipes*/*/*.bb ${LAYERDIR}/recipes*/*/*.bbappend"
#BBFILES += "${LAYERDIR}/recipes*/*.bb ${LAYERDIR}/recipes*/*.bbappend"

BBFILE_COLLECTIONS += "meta-unisoc-test"
BBFILE_PATTERN_meta-unisoc-test := "^${LAYERDIR}/"
BBFILE_PRIORITY_meta-unisoc-test = "8"
```

## meta-unisoc/conf/distro/include/distro-features-cpe.inc
```bitbake
DISTRO_FEATURES_UNISOC_CPE = "ram"
DISTRO_FEATURES_append = " alsa bluez5 ${DISTRO_FEATURES_UNISOC_CPE} "
```

## meta-unisoc/conf/distro/include/runtime-systemd.inc
```bitbake
DISTRO_FEATURES_append = " systemd"
VIRTUAL-RUNTIME_dev_manager = "udev"
VIRTUAL-RUNTIME_login_manager = "busybox"
VIRTUAL-RUNTIME_init_manager = "systemd"
VIRTUAL-RUNTIME_keymaps = "keymaps"
VIRTUAL-RUNTIME_initscripts = "systemd-compat-units"
VIRTUAL-RUNTIME_syslog = "busybox-syslog"
```

## meta-unisoc/conf/distro/include/runtime-sysvinitm.inc
```bitbake
DISTRO_FEATURES_append = " sysvinit"
VIRTUAL-RUNTIME_dev_manager = "busybox-mdev"
VIRTUAL-RUNTIME_login_manager = "busybox"
VIRTUAL-RUNTIME_init_manager = "sysvinit"
VIRTUAL-RUNTIME_keymaps = "keymaps"
VIRTUAL-RUNTIME_initscripts = "initscripts"
VIRTUAL-RUNTIME_syslog = "busybox-syslog"
```

## meta-unisoc/conf/distro/include/runtime-sysvinitu.inc
```bitbake
DISTRO_FEATURES_append = " sysvinit"
VIRTUAL-RUNTIME_dev_manager = "udev"
VIRTUAL-RUNTIME_login_manager = "busybox"
VIRTUAL-RUNTIME_init_manager = "sysvinit"
VIRTUAL-RUNTIME_keymaps = "keymaps"
VIRTUAL-RUNTIME_initscripts = "initscripts"
VIRTUAL-RUNTIME_base-utils-syslog = "rsyslog"
```

## meta-unisoc/conf/distro/include/unisoc-distro.inc
```bitbake
# this file is used for unisoc distro feature

# add for esdk
require conf/distro/include/yocto-uninative.inc
INHERIT += "uninative"

DISTRO_VERSION = "${MACHINE}+${DISTRO}-2.0+${DATE_BUILD}+${USERDEBUG}+native"
DISTRO_VERSION[vardepsexclude] = "DATE"
DISTRO_CODENAME = "dunfell"
SDK_NAME = "${DISTRO}-${TCLIBC}-${SDK_ARCH}-${IMAGE_BASENAME}-${TUNE_PKGARCH}"
SDK_VERSION := "${@'${DISTRO_VERSION}'.replace('snapshot-${DATE}','snapshot')}"
SDK_VERSION[vardepsexclude] = "DATE"
SDK_VENDOR = "-unisocsdk"
SDK_NAME_PREFIX = "${DISTRO}"
SDKPATH = "/opt/${DISTRO}/${SDK_VERSION}"

MAINTAINER = "zhangyong <yong.z@unisoc.com>"

TARGET_VENDOR = "-unisoc"

LOCALCONF_VERSION = "1"

IMAGE_LINGUAS ?= " "

ENABLE_BINARY_LOCALE_GENERATION ?= "0"

DISTRO_FEATURES_DEFAULT ?= " "

DISTRO_FEATURES_BACKFILL = " "

DISTRO_FEATURES_BACKFILL_CONSIDERED += "pulseaudio sysvinit bluez5 gobject-introspection-data ldconfig"

# QA check settings - a little stricter than the OE-Core defaults
WARN_TO_ERROR_QA = "already-stripped compile-host-path install-host-path \
                    installed-vs-shipped ldflags pn-overrides rpaths staticdev \
                    useless-rpaths"
WARN_QA_remove = "${WARN_TO_ERROR_QA}"
ERROR_QA_append = " ${WARN_TO_ERROR_QA}"

INHERIT += "buildhistory"
INHERIT += "image-buildinfo"
BUILDHISTORY_COMMIT = "1"

# GCCVERSION ?= "arm-9.2"

PACKAGE_CLASSES ?= "package_ipk"

USERDEBUG ?= "userdebug"
SECBOOT_ENABLE ?= "sec"
DATE_BUILD ?= "${DATE}"

# avoid BB_NO_NETWORK error
CONNECTIVITY_CHECK_URIS = " "
```

## meta-unisoc/conf/distro/unisoc-console.conf
```bitbake
require conf/distro/include/arm-defaults.inc
require conf/distro/include/unisoc-distro.inc

require conf/distro/include/runtime-systemd.inc
require conf/distro/include/libc-gnu.inc

DSTRO_NAME = "unisoc-console-distro"

MACHINE_ADD_DISTRO_FEATURES ?= " "
MACHINE_REMOVE_DISTRO_FEATURES ?= " "

DISTRO_FEATURES_append = " ${MACHINE_ADD_DISTRO_FEATURES}"
DISTRO_FEATURES_remove = "${MACHINE_REMOVE_DISTRO_FEATURES}"
```

## meta-unisoc/conf/distro/unisoc-sato.conf
```bitbake
require conf/distro/include/arm-defaults.inc
require conf/distro/include/unisoc-dsitro.inc

require conf/distro/include/libc-gnu.inc
require conf/distro/include/runtime-sysvinitm.inc

require conf/distro/include/distro-features-cpe.inc
require conf/distro/include/distro-features-sato.inc

DISTRO_NAME = "unisoc-sato-distro"


MACHINE_ADD_DISTRO_FEATURES ?= " "
MACHINE_REMOVE_DISTRO_FEATURES ?= " "

DISTRO_FEATURES_append = " ${MACHINE_ADD_DISTRO_FEATURES}"
DISTRO_FEATURES_remove = "${MACHINE_REMOVE_DISTRO_FEATURES}"
```

## meta-unisoc/conf/distro/unisoc-tiny.conf
```bitbake
require conf/distro/include/arm-defaults.inc
require conf/distro/include/unisoc-distro.inc

require conf/distro/include/libc-musl.inc
require conf/distro/include/runtime-busybox.inc

DISTRO_NAME = "unisoc-tiny-distro"

MACHINE_ADD_DISTRO_FEATURES ?= " "
MACHINE_REMOVE_DISTRO_FEATURES ?= " "

DISTRO_FEATURES_append = " ${MACHINE_ADD_DISTRO_FEATURES}"
DISTRO_FEATURES_remove = "${MACHINE_REMOVE_DISTRO_FEATURES}"
```

## meta-unisoc/conf/distro/unisoc-wayland.conf
```bitbake
require conf/distro/include/arm-defaults.inc
require conf/distro/include/unisoc-distro.inc

require conf/distro/include/libc-gnu.inc
require conf/distro/include/runtime-sysvinitu.inc

require conf/distro/include/distro-features-cpe.inc
require conf/distro/include/distro-features-wayland.inc

DISTRO_NAME = "unisoc-wayland-distro"


MACHINE_ADD_DISTRO_FEATURES ?= "perflink "
MACHINE_REMOVE_DISTRO_FEATURES ?= " "

DISTRO_FEATURES_append = " ${MACHINE_ADD_DISTRO_FEATURES}"
DISTRO_FEATURES_remove = "${MACHINE_REMOVE_DISTRO_FEATURES}"
```

## meta-unisoc/conf/layer.conf
```bitbake
# We might have a conf and classes directory, append to BBPATH
BBPATH .= ":${LAYERDIR}"

# We have a recipes directory, add to BBFILES
BBFILES += "${LAYERDIR}/recipes*/*/*.bb ${LAYERDIR}/recipes*/*/*.bbappend"
#BBFILES += "${LAYERDIR}/recipes*/*.bb ${LAYERDIR}/recipes*/*.bbappend"

LAYERSERIES_COMPAT_meta-unisoc = "dunfell"
BBFILE_COLLECTIONS += "meta-unisoc"
BBFILE_PATTERN_meta-unisoc := "^${LAYERDIR}/"
BBFILE_PRIORITY_meta-unisoc = "8"

BBFILES_DYNAMIC += " \
    core:${LAYERDIR}/dynamic-layers/oecore-layer/*/*/*.bb \
    core:${LAYERDIR}/dynamic-layers/oecore-layer/*/*/*.bbappend \
    \
"

require machine/recovery.conf
BBMASK = "meta-linaro/meta-linaro/recipes-kernel/perf/perf.bbappend"


LICENSE_PATH += "${LAYERDIR}/common-licenses"
```

## meta-unisoc/conf/machine/include/common/bsp-kernel.inc
```bitbake
# the inc file store commone configuration for unisoc machine
# and would be overwriten by <machine>.conf
# assign should use "?=" and in <machine>.conf use "=" to overwriten

### console configuration
# console config need same as kernel cmdline
CONSOLE_LINUX = "ttyS1"
CONSOLE ?= "${CONSOLE_LINUX}"
SERIAL_CONSOLES ?= "115200;ttyS1"

### kernel dtb/defconfig/patch configuration
KERNEL_DEVICETREE ?= "${KERNEL_DT_SUBDIR}${KERNEL_BOARD_BASE}.dtb"
KERNEL_DEVICETREE_OVERLAY ?= "${KERNEL_DT_SUBDIR}${KERNEL_BOARD}-overlay.dtbo"
KERNEL_DEFCONFIG ?= "sprd_sl8581e_defconfig"
KCONFIG_MODE="--alldefconfig"
KERNEL_PATCH_FILEPATH = "${THISDIR}/${UNISOC_KERNEL_VERSION}/${UNISOC_SOC}"

### For Recovery, recovery now is prebuilts bin
KERNEL_RECOVERY_DEVICETREE ?= "${KERNEL_DT_SUBDIR}recovery-${KERNEL_BOARD}.dtb"
#KERNEL_RECOVERY_DEFCONFIG ?= "recovery_sprd_sharkl3_defconfig"
#UNISOC_KERNEL = "${UNISOC_KERNEL_VERSION}"

### chipram defconfig/patch
CHIPRAM_MACHINE ?= "${UBOOT_BOARD}_config"
CHIPRAM_PATCH_FILEPATH ?= "${THISDIR}/${UNISOC_SOC}"

# uboot dtb/defconfig/patch
UBOOT_MACHINE ?= "${UBOOT_BOARD}_defconfig"
UBOOT_TARGET_DTB ?= "${UBOOT_BOARD}"
U_BOOT_PATCH_FILEPATH = "${THISDIR}/u-boot15/${UNISOC_SOC}"

UBOOT_MERGE_KERNEL_CMDLINE_TO_BOOTARGS ?= "y"
```

## meta-unisoc/conf/machine/include/common/dual-sim.inc
```bitbake
# support dual card
CONNMAN_SUPPORT_DUAL_SIMCARD = "true"
MULTI_SIM_SET = "-DMULTI_SIM_SUPPORT"

# dualsim flag
DUALSIM_FLAG = "true"
```

## meta-unisoc/conf/machine/include/common/ext4-def.inc
```bitbake
# the inc file store commone ext4 rootfs configuration for unisoc machine

### rootfs and partiton configuration
# Define the partition and file system
BASE_FS_TYPE = "ext4"
IMAGE_OVERHEAD_FACTOR = "1.2"

# Fastboot expects an ext4 image, which needs to be 4096 bytes aligned
IMAGE_FSTYPES_append = " ext4.gz"
IMAGE_ROOTFS_ALIGNMENT = "2048"
#EXTRA_IMAGECMD_ext4 += " -L rootf "
IMAGE_ROOTFS_EXTRA_SPACE = "0"
IMAGE_ROOTFS_SIZE = "0"
EXTRA_IMAGE_FEATURES += " read-only-rootfs "

# for mount, fs_tab
USERDATA_PARTITION ?= " /dev/userdata /mnt/userdata ext4 "
PRODNV_PARTITION = " /dev/mmcblk0p1 /etc/productinfo ext4 "
SDCARD_PARTITION = " /dev/mmcblk1p1 /mnt/media auto "
HOME_DIR = " /mnt/userdata/home /home none "
VAR_DIR = "${@bb.utils.contains('IMAGE_FEATURES', 'read-only-rootfs',' /mnt/userdata/var /var none ', '',d)}"
DATA_DIR = " /mnt/userdata/data /mnt/data none "
EXTRA_PARTITIONS ?= "${USERDATA_PARTITION}""${PRODNV_PARTITION}""${DATA_DIR}""${HOME_DIR}""${VAR_DIR}"

USERDATA_FSTYPES = "ext4"
USERDATA_SIZE = "81920"

PRODNV_FSTYPES = "ext4"
PRODNV_SIZE = "4096"

STORAGE_TYPE = "emmc"

EXTRA_IMAGECMD_ext4_pn-unisoc-wayland-image += " -O ^has_journal"
```

## meta-unisoc/conf/machine/include/common/ubifs-def.inc
```bitbake
IMAGE_FSTYPES_append = " ubifs "
MKUBIFS_ARGS ?= "-F -m 4096 -e 253952 -c 4000"
UBINIZE_ARGS ?= "-m 4096 -p 256KiB -s 4096 -O 4096"
IMAGE_ROOTFS_ALIGNMENT = "4096"
EXTRA_IMAGE_FEATURES += " read-only-rootfs "

PRODNV_MKUBIFS_ARGS = ""
IMAGE_ROOTFS_EXTRA_SPACE = "0"
IMAGE_ROOTFS_SIZE = "0"
IMAGE_OVERHEAD_FACTOR = "1.1"

USERDATA_PARTITION = " /dev/ubi0_userdata /mnt/userdata ubifs "
PRODNV_PARTITION = " /dev/ubi0_prodnv /etc/productinfo ubifs "
SDCARD_PARTITION = " /dev/mmcblk0p1 /mnt/media auto "
HOME_DIR = " /mnt/userdata/home /home none "
VAR_DIR = "${@bb.utils.contains('IMAGE_FEATURES', 'read-only-rootfs',' /mnt/userdata/var /var none ', '',d)}"
DATA_DIR = " /mnt/userdata/data /mnt/data none "
EXTRA_PARTITIONS = "${USERDATA_PARTITION}""${PRODNV_PARTITION}""${DATA_DIR}""${HOME_DIR}""${VAR_DIR}"

USERDATA_MKUBIFS_ARGS = "-F -m 4096 -e 253952 -c 4000 -R 20MiB"
USERDATA_FSTYPES = "ubifs"
USERDATA_SIZE = "81920"

PRODNV_MKUBIFS_ARGS = "-F -m 4096 -e 253952 -c 42"
PRODNV_FSTYPES = "ubifs"
PRODNV_SIZE = "2980"
```

## meta-unisoc/conf/machine/include/common/unisoc-common.inc
```bitbake
# the inc file store commone configuration for unisoc machine
# and would be overwriten by <machine>.conf
# assign should use "?=" and in <machine>.conf use "=" to overwriten

### external src configuration
require conf/machine/include/unisoc-extern.inc

### bsp kernel configuration
require conf/machine/include/common/bsp-kernel.inc
```

## meta-unisoc/conf/machine/include/cpe.inc
```bitbake
#@TYPE: product
#@NAME: CPE product
#@DESCRIPTION: UNISOC CPE product

MACHINE_FEATURES = "modem connman radio engpc "
```

## meta-unisoc/conf/machine/include/s9863a/camera.inc
```bitbake
###for camera###
CAMERA_BOARD="sc9863a-1h10"
CAMERA_TARGET_BOARD_CAMERA_CPP_MODULAR_KERNEL="lite_r5p0"

CAMERA_ISP_DIR="isp2.6"
CAMERA_DRIVER_DIR="k5.4_sprdroidt"
CAMERA_BSP_BOARD_CAMERA_MODULE_ISP_VERSION="isp2.6"
CAMERA_BSP_BOARD_CAMERA_MODULE_CPP_VERSION="lite_r4p0"
CAMERA_BSP_BOARD_CAMERA_MODULE_CSI_VERSION="receiver_r2p0"
CAMERA_BSP_BOARD_CAMERA_MODULE_ISP_ADAPT_VERSION="sharkl3"
CAMERA_FLASH_IC_VERSION="ocp8137"

TEST_A_DRIVER_DIR="yocto_drv_src_code"

TEST_A_BSP_BOARD_CAMERA_MODULE_ISP_VERSION="test_a"
TARGET_BOARD_CAMERA_ISP_VERSION="2.5"
###end camera###
```

## meta-unisoc/conf/machine/include/s9863a/gpu.inc
```bitbake
### For GPU ###
GPU_PLATFORM = "sharkl3"
GPU_RGX_BVNC = "22.86.104.218"
### End GPU ###
```

## meta-unisoc/conf/machine/include/s9863a/s9863a.inc
```bitbake
require conf/machine/include/arm/arch-arm64.inc

UNISOC_SOC = "s9863a"
KERNEL_BOARD_BASE = "sp9863a"

UNISOC_KERNEL_VERSION = "linux-unisoc-5.4"
PREFERRED_PROVIDER_virtual/kernel = "${UNISOC_KERNEL_VERSION}"

KERNEL_IMAGETYPE = "Image"
UNISOC_BOOTIMG_PAGE_SIZE = "2048"
UNISOC_BOOTIMG_KERNEL_BASE = "0x00000000"
BOARD_MKBOOTIMG_ARGS = "--kernel_offset 0x00008000 --ramdisk_offset 0x012e9800"

SML_VERSION = "1.4"
TEE_64BIT = "true"

SENSOR_PROJECT="sharkl3_cm4"
EXTRA_IMAGEDEPENDS += "u-boot15"
EXTRA_IMAGEDEPENDS += "chipram"

# virtualization configuration
SKIP_META_VIRT_SANITY_CHECK = "1"
```

## meta-unisoc/conf/machine/include/s9863a/trusty.inc
```bitbake
BOARD_SECBOOT_CONFIG = "${@bb.utils.contains('SECBOOT_ENABLE','sec','true','false',d)}"
UNISOC_SIGN_ENABLE = "yes"
UNISOC_SIGN_PSS = "pkcs15"
PROJECT_FLAG = "OTHER"
BSP_SPRD_SECUREBOOT_ALGORITHM = "rsa2048"
SECURE_WCN_GNSS_ENABLE = "${@bb.utils.contains('SECBOOT_ENABLE','sec','true','false',d)}"

### SECBOOT_ENABLE configuration which influence compile
### START secboot and vbootv2 configs for uboot
UBOOT_SECSET = "${@bb.utils.contains('SECBOOT_ENABLE','sec','-DCONFIG_SECBOOT -DCONFIG_SPRD_SECBOOT','',d)}"
UBOOT_SECSET += "${@bb.utils.contains('SECURE_WCN_GNSS_ENABLE','true','-DVERIFY_WCN_GNSS','',d)}"
### END secboot and vbootv2 configs for uboot

### START secboot and vbootv2 configs for chipram
CHIPRAM_SECSET = "${@bb.utils.contains('SECBOOT_ENABLE','sec','-DCONFIG_SECBOOT -DCONFIG_SPRD_SECBOOT','',d)}"
### END secboot and vbootv2 configs for chipram

### START secboot and vbootv2 configs for modem_ctrl
MODEM_SECSET = "${@bb.utils.contains('SECBOOT_ENABLE','sec','-DCONFIG_SECBOOT -DCONFIG_SPRD_SECBOOT','',d)}"
MODEM_LDKERNELBOOTCP = "${@bb.utils.contains('SECBOOT_ENABLE','sec','-lkernelbootcp','',d)}"
### END secboot and vbootv2 configs for modem_ctrl
### END BOARD_SECBOOT_CONFIG



### START SML/TEECFG/TOS configs ###
SML_CONFIG = "sharkl3@sharkl3"
TEE_CONFIG = "trusty"

SML_MEM_ADDR ?= "0xb0000000"
SML_MEM_SIZE ?= "0x00040000"

TEECFG_CUSTOM = "true"
TEECFG_MEM_ADDR ?= "0xb0040000"
TEECFG_MEM_SIZE ?= "0x20000"


TRUSTY_DEFAULT_PROJECT = "sl8581e"
TOS_MEM_ADDR ?= "0xb0060000"
TOS_MEM_SIZE ?= "0x01fa0000"


EXTRA_IMAGEDEPENDS += "sml"
EXTRA_IMAGEDEPENDS += "teecfg"
EXTRA_IMAGEDEPENDS += "trusty"
### END SML and TOS configs ###
```

## meta-unisoc/conf/machine/include/uis8520/gpu.inc
```bitbake
### For GPU ###
GPU_PLATFORM = ""
GPU_RGX_BVNC = ""

# use libnatt instead of mesa for EGL & GLES libraries
PREFERRED_PROVIDER_virtual/egl = "libnatt"
PREFERRED_PROVIDER_virtual/libgl = "libnatt"
PREFERRED_PROVIDER_virtual/libgles1 = "libnatt"
PREFERRED_PROVIDER_virtual/libgles2 = "libnatt"
PREFERRED_PROVIDER_virtual/libgbm = "libnatt"
PREFERRED_PROVIDER_virtual/mesa = "libnatt"

### End GPU ###
```
